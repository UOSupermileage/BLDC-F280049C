// These arguments were used when this file was generated. They will be automatically applied on subsequent loads 
// via the GUI or CLI invocations. Run CLI with '--help' for additional information on how to override these arguments.
// @cliArgs --device "F28004x" --package "F28004x_100PZ" --part "F28004x_100PZ"
// @versions {"data":"2018081511","timestamp":"2018081511","tool":"1.0.414","templates":"2018081511"}

var TILE = scripting.addModule("/utilities/clb_tool/clb_syscfg/source/TILE");
var TILE1 = TILE.addInstance();
// clock_period - Period of the clock (in Nano Seconds) used for simulation in System C
TILE.clock_period = 10;
// sim_duration - Duration of the simulation (in Nano Seconds)
TILE.sim_duration = 100000;
// Name
TILE1.$name = "TILE1";
// in_duty1 - Duty or ON time of the square wave
TILE1.BOUNDARY.in_duty1 = 50;
// in_period1 - Period of the square wave
TILE1.BOUNDARY.in_period1 = 100;
// in_repeat_count0 - Number of periods the waveform is repeated
TILE1.BOUNDARY.in_repeat_count0 = 50;
// in_repeat_count3 - Number of periods the waveform is repeated
TILE1.BOUNDARY.in_repeat_count3 = 1;
// in_repeat_count1 - Number of periods the waveform is repeated
TILE1.BOUNDARY.in_repeat_count1 = 1000;
// in_duty0 - Duty or ON time of the square wave
TILE1.BOUNDARY.in_duty0 = 20;
// in_period0 - Period of the square wave
TILE1.BOUNDARY.in_period0 = 40;
// in0
TILE1.BOUNDARY.in0 = "squareWave";
// in1
TILE1.BOUNDARY.in1 = "squareWave";
// i0 - Input 0.
TILE1.LUT_0.i0 = "BOUNDARY.in0";
// i1 - Input 1.
TILE1.LUT_0.i1 = "BOUNDARY.in1";
// eqn - Boolean equation on the variables i3,i2,i1,i0 for the LUT output.
TILE1.LUT_0.eqn = "i0 & i1";
// i0 - Input 0.
TILE1.OUTLUT_4.i0 = "LUT_0.OUT";
// eqn - Boolean equation on the variables i2,i1,i0 for the OUTLUT output.
TILE1.OUTLUT_4.eqn = "i0";
